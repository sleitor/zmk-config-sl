## boards/shields/souffle_v3_sweep/Kconfig.shield
```kconfig
config SHIELD_SOUFFLE_V3_SWEEP_LEFT
    def_bool $(shields_list_contains,souffle_v3_sweep_left)

config SHIELD_SOUFFLE_V3_SWEEP_RIGHT
    def_bool $(shields_list_contains,souffle_v3_sweep_right)
```

## config/boards/shields/souffle_v3_sweep/Kconfig.defconfig
```kconfig
if SHIELD_SOUFFLE_V3_SWEEP_LEFT

config ZMK_KEYBOARD_NAME
    default "Souffle v3 Sweep"

config ZMK_SPLIT_ROLE_CENTRAL
    default y

endif

if SHIELD_SOUFFLE_V3_SWEEP_LEFT || SHIELD_SOUFFLE_V3_SWEEP_RIGHT

config ZMK_SPLIT
    default y

endif
```
