/*
 * Copyright (c) 2025 The ZMK Contributors
 * SPDX-License-Identifier: MIT
 */

#include "souffle_v3_sweep.dtsi"

&kscan0 {
    col-gpios
        = <&pro_micro 6  GPIO_ACTIVE_HIGH> // F6
        , <&pro_micro 7  GPIO_ACTIVE_HIGH> // F7
        , <&pro_micro 10 GPIO_ACTIVE_HIGH> // B1
        , <&pro_micro 19 GPIO_ACTIVE_HIGH> // B3
        , <&pro_micro 20 GPIO_ACTIVE_HIGH> // B2
        , <&pro_micro 21 GPIO_ACTIVE_HIGH> // B6
        ;
};

&left_encoder {
    status = "okay";
};

&nice_view_spi {
    cs-gpios = <&pro_micro 0 GPIO_ACTIVE_HIGH>;
};